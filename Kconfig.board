## Kconfig.board
```kconfig
# M5 Stamp-C3 board configuration

# Copyright (c) 2021 Espressif Systems (Shanghai) Co., Ltd.
# SPDX-License-Identifier: Apache-2.0

config BOARD_M5_STAMP-C3
	bool "M5 Stamp -C3 Board"
	depends on SOC_ESP32C3
	select CONSOLE_HAS_DRIVER
```

## Kconfig.defconfig
```kconfig
# M5 Stamp-C3 board configuration

# Copyright (c) 2021 Espressif Systems (Shanghai) Co., Ltd.
# SPDX-License-Identifier: Apache-2.0

config BOARD
	default "m5_stamp-c3"
	depends on BOARD_M5_STAMP-C3

config ENTROPY_ESP32_RNG
	default y if ENTROPY_GENERATOR

if BT

config HEAP_MEM_POOL_SIZE
	default 16384

choice BT_HCI_BUS_TYPE
	default BT_ESP32
endchoice

endif # BT
```
